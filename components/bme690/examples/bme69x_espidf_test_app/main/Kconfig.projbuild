## components/bme690/examples/bme69x_espidf_test_app/main/Kconfig.projbuild
```kconfig
menu "Example Configuration"

    config I2C_MASTER_SCL
        int "SCL GPIO Num"
        default 5
        help
            GPIO number for I2C Master clock line.

    config I2C_MASTER_SDA
        int "SDA GPIO Num"
        default 4
        help
            GPIO number for I2C Master data line.

    config BME690_SDO_PULLED_DOWN
        bool "BME690 SDO Pin Pulled Down to GND"
            default n
        help
            Enable if SDO pin is pulled down, disable if SDO pin is pulled up. This will decide the i2c address.

endmenu
```

## components/bme690/examples/bme69x_espidf_test_app/sdkconfig.defaults
```kconfig
# For IDF 5.0
CONFIG_ESP_TASK_WDT_EN=n

# For IDF4.4
CONFIG_ESP_TASK_WDT=n

CONFIG_ESP_CONSOLE_USB_SERIAL_JTAG=y
CONFIG_I2C_MASTER_SDA=18
CONFIG_I2C_MASTER_SCL=20

CONFIG_I2C_BUS_BACKWARD_CONFIG=y
```

## compute_badgevms/Kconfig.projbuild
```kconfig
menu "WHY2025 Custom Board Selection"

    choice
        prompt "Select your WHY2025 target board"
        default WHY2025_TARGET_WHY2025_V21

        config WHY2025_TARGET_WHY2025_V21
            bool "why2025 v2.1 carrier board"

        config WHY2025_TARGET_WHY2025_V2
            bool "why2025 v2.5 carrier board (older than v2.1)"

    endchoice

    choice
        prompt "Screen manufacturer"
        depends on WHY2025_TARGET_WHY2025_V21 || WHY2025_TARGET_WHY2025_V2
        default SCREEN_TYPE_MOUNTAIN if WHY2025_TARGET_WHY2025_V2
        default SCREEN_TYPE_BONO if WHY2025_TARGET_WHY2025_V21

        config SCREEN_TYPE_MOUNTAIN
            bool "Screen manufactured by Mountain (Blue border)"
            help 
                The screens have a blue border where the ribbon cable is connected

        config SCREEN_TYPE_BONO
            bool "Screen manufactured by Bono (Black border)"
            help 
                The screens have a black border where the ribbon cable is connected
    endchoice

endmenu
```

## sdkconfig.defaults
```kconfig
CONFIG_ESPTOOLPY_FLASHSIZE_16MB=y
CONFIG_PARTITION_TABLE_CUSTOM=y
CONFIG_COMPILER_OPTIMIZATION_PERF=y
CONFIG_COMPILER_WARN_WRITE_STRINGS=y
CONFIG_COMPILER_SAVE_RESTORE_LIBCALLS=y
# CONFIG_ANA_CMPR_ISR_HANDLER_IN_IRAM is not set
# CONFIG_GPTIMER_ISR_HANDLER_IN_IRAM is not set
# CONFIG_I2C_MASTER_ISR_HANDLER_IN_IRAM is not set
# CONFIG_MCPWM_ISR_HANDLER_IN_IRAM is not set
# CONFIG_PARLIO_TX_ISR_HANDLER_IN_IRAM is not set
# CONFIG_PARLIO_RX_ISR_HANDLER_IN_IRAM is not set
# CONFIG_RMT_ENCODER_FUNC_IN_IRAM is not set
# CONFIG_RMT_TX_ISR_HANDLER_IN_IRAM is not set
# CONFIG_RMT_RX_ISR_HANDLER_IN_IRAM is not set
CONFIG_SPI_MASTER_IN_IRAM=y
# CONFIG_SPI_SLAVE_ISR_IN_IRAM is not set
# CONFIG_ETH_USE_ESP32_EMAC is not set
# CONFIG_ETH_USE_SPI_ETHERNET is not set
# CONFIG_ESP_EVENT_POST_FROM_ISR is not set
CONFIG_ESP_HTTP_CLIENT_ENABLE_BASIC_AUTH=y
CONFIG_ESP_HTTP_CLIENT_ENABLE_DIGEST_AUTH=y
CONFIG_DMA2D_OPERATION_FUNC_IN_IRAM=y
CONFIG_DMA2D_ISR_IRAM_SAFE=y
CONFIG_ESP_BROWNOUT_DET_LVL_SEL_5=y
# CONFIG_ESP_NETIF_REPORT_DATA_TRAFFIC is not set
CONFIG_SPIRAM=y
CONFIG_SPIRAM_SPEED_200M=y
# CONFIG_SPIRAM_BOOT_INIT is not set
CONFIG_SPIRAM_USE_MEMMAP=y
CONFIG_SPIRAM_TRY_ALLOCATE_WIFI_LWIP=y
CONFIG_CACHE_L2_CACHE_256KB=y
CONFIG_CACHE_L2_CACHE_LINE_128B=y
CONFIG_ESP_SYSTEM_PANIC_PRINT_HALT=y
# CONFIG_ESP_SYSTEM_PMP_IDRAM_SPLIT is not set
CONFIG_ESP_MAIN_TASK_STACK_SIZE=8192
# CONFIG_ESP_INT_WDT is not set
# CONFIG_ESP_TASK_WDT_EN is not set
# CONFIG_ESP_DEBUG_OCDAWARE is not set
CONFIG_FATFS_LFN_HEAP=y
CONFIG_FREERTOS_TIMER_TASK_AFFINITY_CPU0=y
# CONFIG_FREERTOS_TLSP_DELETION_CALLBACKS is not set
CONFIG_FREERTOS_TASK_PRE_DELETION_HOOK=y
CONFIG_LOG_DEFAULT_LEVEL_WARN=y
# CONFIG_LWIP_DNS_SUPPORT_MDNS_QUERIES is not set
CONFIG_LWIP_IP4_REASSEMBLY=y
CONFIG_LWIP_IP6_REASSEMBLY=y
CONFIG_LWIP_DHCP_OPTIONS_LEN=69
# CONFIG_LWIP_DHCPS is not set
CONFIG_LWIP_AUTOIP=y
CONFIG_LWIP_IPV6_AUTOCONFIG=y
CONFIG_LWIP_IPV6_DHCP6=y
CONFIG_LWIP_TCP_OOSEQ_MAX_PBUFS=4
CONFIG_LWIP_TCPIP_TASK_AFFINITY_CPU0=y
CONFIG_LWIP_DNS_MAX_SERVERS=2
CONFIG_LWIP_DNS_SETSERVER_WITH_NETIF=y
# CONFIG_LWIP_ESP_LWIP_ASSERT is not set
CONFIG_MBEDTLS_SSL_PROTO_TLS1_3=y
# CONFIG_MQTT_PROTOCOL_311 is not set
# CONFIG_MQTT_TRANSPORT_SSL is not set
CONFIG_LIBC_OPTIMIZED_MISALIGNED_ACCESS=y
# CONFIG_ESP_PROTOCOMM_SUPPORT_SECURITY_VERSION_0 is not set
# CONFIG_ESP_PROTOCOMM_SUPPORT_SECURITY_VERSION_1 is not set
# CONFIG_ESP_PROTOCOMM_SUPPORT_SECURITY_VERSION_2 is not set
CONFIG_PTHREAD_DEFAULT_CORE_1=y
CONFIG_SPI_FLASH_SUPPORT_GD_CHIP=y
# CONFIG_SPI_FLASH_ENABLE_ENCRYPTED_READ_WRITE is not set
CONFIG_SPIFFS_MAX_PARTITIONS=1
# CONFIG_SPIFFS_CACHE is not set
# CONFIG_SPIFFS_PAGE_CHECK is not set
# CONFIG_SPIFFS_USE_MAGIC is not set
# CONFIG_SPIFFS_USE_MTIME is not set
# CONFIG_WS_TRANSPORT is not set
# CONFIG_UNITY_ENABLE_FLOAT is not set
# CONFIG_UNITY_ENABLE_DOUBLE is not set
# CONFIG_UNITY_ENABLE_IDF_TEST_RUNNER is not set
# CONFIG_ELF_LOADER_LOAD_PSRAM is not set
# CONFIG_ELF_LOADER_ESPIDF_SYMBOLS is not set
CONFIG_WIFI_RMT_STATIC_RX_BUFFER_NUM=10
CONFIG_WIFI_RMT_RX_BA_WIN=6
# CONFIG_WIFI_RMT_IRAM_OPT is not set
# CONFIG_WIFI_RMT_EXTRA_IRAM_OPT is not set
# CONFIG_WIFI_RMT_RX_IRAM_OPT is not set
# CONFIG_WIFI_RMT_SLP_IRAM_OPT is not set
# CONFIG_WIFI_RMT_SOFTAP_SUPPORT is not set
CONFIG_WIFI_RMT_WAPI_PSK=y
CONFIG_WIFI_RMT_ENT_FREE_DYNAMIC_BUFFER=y
CONFIG_IDF_EXPERIMENTAL_FEATURES=y
```
